## beepberry_os/bcm2708-rpi-zero-w/sharp_drm/sharp_drm/Config.in
```kconfig
config BR2_PACKAGE_SHARP_DRM
        bool "sharp_drm"
        depends on BR2_LINUX_KERNEL
        depends on BR2_PACKAGE_LIBDRM
        help
                DRM driver for Sharp Memory LCD
```
